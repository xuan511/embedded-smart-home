## main/Kconfig.projbuild
```kconfig
menu "Smart Home"
    config HOME_UI
        bool "Enable LCD and GT1151 touch home page"
        default y
    config HOME_SIMULATION
        bool "Explicit OFFLINE simulation (never used as USB fallback)"
        default n
        help
            Does not start the two-board USB link. LCD always says SIMULATION.
            Real sensors and load outputs belong exclusively to STM32.
    config HOME_SD_LOG
        bool "Append CSV to inserted FAT microSD every 10 seconds"
        default n
    config HOME_CAMERA
        bool "Optional existing camera probe (outside acceptance scope)"
        select CAMERA_OV3660
        default n
    menu "Network"
        config HOME_NETWORK
            bool "Compile Wi-Fi, LAN phone API and MQTT upload"
            default y
        config HOME_WIFI_SSID
            string "Wi-Fi SSID (empty disables networking at runtime)"
            default ""
            depends on HOME_NETWORK
        config HOME_WIFI_PASSWORD
            string "Wi-Fi password"
            default ""
            depends on HOME_NETWORK
        config HOME_API_TOKEN
            string "LAN API token: 16..64 letters/digits/underscore/hyphen"
            default ""
            depends on HOME_NETWORK
        config HOME_DEVICE_ID
            string "Unique MQTT device ID: 1..32 letters/digits/underscore/hyphen"
            default "korvo01"
            depends on HOME_NETWORK
        config HOME_MQTT_URI
            string "LAN broker mqtt://IP:1883 (empty disables upload)"
            default ""
            depends on HOME_NETWORK
        config HOME_MQTT_USERNAME
            string "MQTT username (empty for broker without authentication)"
            default ""
            depends on HOME_NETWORK
        config HOME_MQTT_PASSWORD
            string "MQTT password"
            default ""
            depends on HOME_NETWORK
    endmenu
endmenu
```

## sdkconfig.defaults
```kconfig
CONFIG_IDF_TARGET="esp32s31"
CONFIG_ESPTOOLPY_FLASHSIZE_16MB=y
CONFIG_PARTITION_TABLE_CUSTOM=y
CONFIG_PARTITION_TABLE_CUSTOM_FILENAME="partitions.csv"
CONFIG_SPIRAM=y
CONFIG_SPIRAM_MODE_OCT=y
CONFIG_SPIRAM_SPEED_200M=y
CONFIG_FREERTOS_HZ=1000
CONFIG_BSP_ERROR_CHECK=n
CONFIG_BSP_SD_FORMAT_ON_MOUNT_FAIL=n
CONFIG_CODEC_I2C_BACKWARD_COMPATIBLE=n
CONFIG_LV_USE_FLEX=y
CONFIG_LV_USE_FLOAT=y
CONFIG_LV_BUILD_EXAMPLES=n
CONFIG_LV_BUILD_DEMOS=n
CONFIG_ESP_CONSOLE_UART_DEFAULT=y
```
